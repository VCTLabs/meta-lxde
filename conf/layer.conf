## conf/layer.conf
```bitbake
# We have a conf and classes directory, append to BBPATH
BBPATH .= ":${LAYERDIR}"

# We have recipes-* directories, add to BBFILES
BBFILES += "${LAYERDIR}/recipes-*/*/*.bb ${LAYERDIR}/recipes-*/*/*.bbappend"

BBFILE_COLLECTIONS += "lxde-layer"
BBFILE_PATTERN_lxde-layer := "^${LAYERDIR}/"
BBFILE_PRIORITY_lxde-layer = "7"

LAYERDEPENDS_lxde-layer = "core openembedded-layer"
LAYERSERIES_COMPAT_lxde-layer = "warrior zeus"
```
